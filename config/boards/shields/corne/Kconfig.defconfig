## config/boards/shields/corne/Kconfig.defconfig
```kconfig
if SHIELD_CORNE_LEFT

config ZMK_KEYBOARD_NAME
    default "Corne"

config ZMK_SPLIT_BLE_ROLE_CENTRAL
    default y

endif

if SHIELD_CORNE_LEFT || SHIELD_CORNE_RIGHT

config ZMK_SPLIT
    default y

endif

if ZMK_DISPLAY

config I2C
	default y

config SSD1306
	default y

config SSD1306_REVERSE_MODE
	default y

endif 
```

## config/boards/shields/crotary/Kconfig.defconfig
```kconfig
if SHIELD_CROTARY_LEFT

config ZMK_KEYBOARD_NAME
    default "Crotary"

config ZMK_SPLIT_BLE_ROLE_CENTRAL
    default y

endif

if SHIELD_CROTARY_LEFT || SHIELD_CROTARY_RIGHT

config ZMK_SPLIT
    default y

endif
```

## config/boards/shields/crotary/Kconfig.shield
```kconfig
config SHIELD_CROTARY_LEFT
    def_bool $(shields_list_contains,crotary_left)

config SHIELD_CROTARY_RIGHT
    def_bool $(shields_list_contains,crotary_right)
```
